## buildroot-external/package/plog/Config.in
```kconfig
config BR2_PACKAGE_PLOG
  bool "plog"
  depends on BR2_INSTALL_LIBSTDCPP
  help
    Portable, simple and extensible C++ logging library
```

## buildroot-external/package/uwe5622/Config.in
```kconfig
config BR2_PACKAGE_UWE5622
  bool "UWE5622 Wi-Fi/BT driver"
  depends on BR2_LINUX_KERNEL
  help
    Unisoc UWE5622 Wi-Fi/BT driver for Linux.
```

## configs/bananapi_m2-zero_defconfig
```kconfig
BR2_arm=y
BR2_cortex_a7=y
BR2_ARM_FPU_NEON_VFPV4=y

BR2_PACKAGE_HOST_LINUX_HEADERS_CUSTOM_5_15=y
BR2_ROOTFS_DEVICE_CREATION_DYNAMIC_MDEV=y
BR2_ROOTFS_OVERLAY="$(BR2_EXTERNAL_PPUZICKS_PATH)/board/bananapi/m2-zero/rootfs_overlay"

BR2_TOOLCHAIN_BUILDROOT_GLIBC=y
BR2_TOOLCHAIN_BUILDROOT_CXX=y

# Kernal
BR2_LINUX_KERNEL=y
BR2_LINUX_KERNEL_CUSTOM_VERSION=y
BR2_LINUX_KERNEL_CUSTOM_VERSION_VALUE="5.15.43"
BR2_LINUX_KERNEL_DEFCONFIG="sunxi"
BR2_LINUX_KERNEL_DTS_SUPPORT=y
BR2_LINUX_KERNEL_INTREE_DTS_NAME="sun8i-h2-plus-bananapi-m2-zero"
#BR2_LINUX_KERNEL_CUSTOM_DTS_PATH="$(BR2_EXTERNAL_PPUZICKS_PATH)/board/bananapi/m2-zero/dts/sun8i-h2-plus-bananapi-m2-zero.dts"
BR2_LINUX_KERNEL_CONFIG_FRAGMENT_FILES="$(BR2_EXTERNAL_PPUZICKS_PATH)/board/bananapi/m2-zero/linux-extras.config"

BR2_TARGET_ROOTFS_EXT2=y
BR2_TARGET_ROOTFS_EXT2_4=y
BR2_TARGET_ROOTFS_EXT2_SIZE="512M"

# BR2_TARGET_ROOTFS_TAR is not set
BR2_TARGET_UBOOT=y
BR2_TARGET_UBOOT_BOARDNAME="bananapi_m2_zero"
BR2_TARGET_UBOOT_CUSTOM_VERSION=y
BR2_TARGET_UBOOT_CUSTOM_VERSION_VALUE="2022.01"
BR2_TARGET_UBOOT_NEEDS_DTC=y
BR2_TARGET_UBOOT_NEEDS_PYTHON3=y
BR2_TARGET_UBOOT_NEEDS_PYLIBFDT=y
BR2_TARGET_UBOOT_FORMAT_CUSTOM=y
BR2_TARGET_UBOOT_FORMAT_CUSTOM_NAME="u-boot-sunxi-with-spl.bin"
BR2_PACKAGE_HOST_UBOOT_TOOLS=y
BR2_PACKAGE_HOST_UBOOT_TOOLS_BOOT_SCRIPT=y
BR2_PACKAGE_HOST_UBOOT_TOOLS_BOOT_SCRIPT_SOURCE="$(BR2_EXTERNAL_PPUZICKS_PATH)/board/bananapi/m2-zero/boot.cmd"

# Filesystem
BR2_TARGET_GENERIC_HOSTNAME="m2-zero"
BR2_TARGET_GENERIC_ISSUE="Welcome to Buildroot for the Bananapi M2 Zero"
BR2_PACKAGE_HOST_DOSFSTOOLS=y
BR2_PACKAGE_HOST_GENIMAGE=y
BR2_PACKAGE_HOST_MTOOLS=y
BR2_ROOTFS_POST_IMAGE_SCRIPT="support/scripts/genimage.sh"
BR2_ROOTFS_POST_SCRIPT_ARGS="-c $(BR2_EXTERNAL_PPUZICKS_PATH)/board/bananapi/m2-zero/genimage.cfg"

# Wireless firmware
BR2_PACKAGE_LINUX_FIRMWARE=y
BR2_PACKAGE_LINUX_FIRMWARE_BRCM_BCM43XXX=y
BR2_PACKAGE_ARMBIAN_FIRMWARE=y
BR2_PACKAGE_ARMBIAN_FIRMWARE_AP6212=y


# Wireless tools
BR2_PACKAGE_IW=y
BR2_PACKAGE_WIRELESS_TOOLS=y
BR2_PACKAGE_WIRELESS_TOOLS_LIB=y
BR2_PACKAGE_WPA_SUPPLICANT=y
BR2_PACKAGE_WPA_SUPPLICANT_NL80211=y
BR2_PACKAGE_WPA_SUPPLICANT_CLI=y
BR2_PACKAGE_WPA_SUPPLICANT_AUTOSCAN=y
BR2_PACKAGE_WPA_SUPPLICANT_WPA3=y
BR2_PACKAGE_WPA_SUPPLICANT_PASSPHRASE=y
BR2_PACKAGE_WPA_SUPPLICANT_AP_SUPPORT=y
BR2_PACKAGE_WPA_SUPPLICANT_EAP=y
BR2_PACKAGE_WPA_SUPPLICANT_WPS=y
BR2_PACKAGE_WPA_SUPPLICANT_DEBUG_SYSLOG=y
BR2_PACKAGE_WPA_SUPPLICANT_DBUS=y
BR2_PACKAGE_WPA_SUPPLICANT_DBUS_INTROSPECTION=y

BR2_INIT_SYSTEMD=y
BR2_PACKAGE_NETWORK_MANAGER=n

# sunxi package 
BR2_PACKAGE_SUNXI_TOOLS=y


# connman package
BR2_PACKAGE_CONNMAN=y
BR2_PACKAGE_CONNMAN_IPTABLES=y
#BR2_PACKAGE_CONNMAN_ETHERNET=y
BR2_PACKAGE_CONNMAN_WIFI=y
BR2_PACKAGE_CONNMAN_BLUETOOTH=y
BR2_PACKAGE_CONNMAN_LOOPBACK=y
BR2_PACKAGE_CONNMAN_CLIENT=y

# systemd package
BR2_PACKAGE_SYSTEMD_RFKILL=y

# bluetooth
BR2_PACKAGE_BLUEZ5_UTILS=y
BR2_PACKAGE_BLUEZ5_UTILS_CLIENT=y
BR2_PACKAGE_BLUEZ5_UTILS_TOOLS=y
BR2_PACKAGE_BLUEZ5_UTILS_DEPRECATED=y
BR2_PACKAGE_BLUEZ5_UTILS_PLUGINS_MESH=n
BR2_PACKAGE_BRCM_PATCHRAM_PLUS=n

# 3D
BR2_PACKAGE_MESA3D=n
BR2_PACKAGE_MESA3D_GALLIUM_DRIVER_LIMA=n
BR2_PACKAGE_MESA3D_OPENGL_EGL=n
BR2_PACKAGE_MESA3D_OPENGL_ES=n

# Home Sensor
BR2_PACKAGE_LE_GATEWAY=y
BR2_PACKAGE_SDBUSCPP=y
BR2_PACKAGE_PLOG=y
BR2_PACKAGE_JSON_FOR_MODERN_CPP=y
BR2_PACKAGE_VSFTPD=y
```

## configs/haoyu_a20_marsboard_defconfig
```kconfig
# Architecture
BR2_arm=y
BR2_cortex_a7=y
BR2_ARM_EABIHF=y

BR2_GLOBAL_PATCH_DIR="$(BR2_EXTERNAL_PPUZICKS_PATH)/board/haoyu/a20_marsboard/patches"
# Linux headers same as kernel, a 5.10 series
BR2_PACKAGE_HOST_LINUX_HEADERS_CUSTOM_5_10=y

# Toolchain
# glibc is needed for sunxi-mali-mainline-package.
BR2_TOOLCHAIN_BUILDROOT_GLIBC=y
BR2_TOOLCHAIN_BUILDROOT_CXX=y

# System configuration
BR2_TARGET_GENERIC_HOSTNAME="a20-marsboard"
BR2_TARGET_GENERIC_ISSUE="Welcome to MarsBoard A20!"
#BR2_TARGET_GENERIC_GETTY=y
#BR2_TARGET_GENERIC_GETTY_PORT="ttyS0"
#BR2_ROOTFS_POST_BUILD_SCRIPT="$(BR2_EXTERNAL_PPUZICKS_PATH)/board/haoyu/a20_marsboard/post-build.sh"
BR2_PACKAGE_HOST_DOSFSTOOLS=y
BR2_PACKAGE_HOST_GENIMAGE=y
BR2_PACKAGE_HOST_MTOOLS=y
BR2_ROOTFS_POST_IMAGE_SCRIPT="support/scripts/genimage.sh"
BR2_ROOTFS_POST_SCRIPT_ARGS="-c $(BR2_EXTERNAL_PPUZICKS_PATH)/board/haoyu/a20_marsboard/genimage.cfg"
BR2_ROOTFS_OVERLAY="$(BR2_EXTERNAL_PPUZICKS_PATH)/board/haoyu/a20_marsboard/rootfs_overlay"

# kernel
BR2_LINUX_KERNEL=y
BR2_LINUX_KERNEL_CUSTOM_VERSION=y
BR2_LINUX_KERNEL_CUSTOM_VERSION_VALUE="5.10.48"
#BR2_LINUX_KERNEL_PATCH="$(BR2_EXTERNAL_PPUZICKS_PATH)/board/haoyu/a20_marsboard/patches/linux/"
#BR2_LINUX_KERNEL_USE_CUSTOM_CONFIG=y
#BR2_LINUX_KERNEL_CUSTOM_CONFIG_FILE="$(BR2_EXTERNAL_PPUZICKS_PATH)/board/haoyu/a20_marsboard/ppuzick_a20_linux_config"
BR2_LINUX_KERNEL_USE_DEFCONFIG=y
BR2_LINUX_KERNEL_DEFCONFIG="sunxi"
BR2_LINUX_KERNEL_DTS_SUPPORT=y
BR2_LINUX_KERNEL_CUSTOM_DTS_PATH="$(BR2_EXTERNAL_PPUZICKS_PATH)/board/haoyu/a20_marsboard/dts/linux/sun7i-a20-marsboard.dts"
#BR2_LINUX_KERNEL_INSTALL_TARGET=y
BR2_LINUX_KERNEL_CONFIG_FRAGMENT_FILES="$(BR2_EXTERNAL_PPUZICKS_PATH)/board/haoyu/a20_marsboard/linux-extras.config"


# sunxi package 
BR2_PACKAGE_SUNXI_TOOLS=y


# Filesystem
BR2_TARGET_ROOTFS_EXT2=y
BR2_TARGET_ROOTFS_EXT2_4=y
BR2_TARGET_ROOTFS_EXT2_SIZE="512M"

# Bootloaders
BR2_TARGET_UBOOT=y
BR2_TARGET_UBOOT_BUILD_SYSTEM_KCONFIG=y
BR2_TARGET_UBOOT_CUSTOM_VERSION=y
BR2_TARGET_UBOOT_CUSTOM_VERSION_VALUE="2021.07"
BR2_TARGET_UBOOT_USE_CUSTOM_CONFIG=y
BR2_TARGET_UBOOT_CUSTOM_CONFIG_FILE="$(BR2_EXTERNAL_PPUZICKS_PATH)/board/haoyu/a20_marsboard/Marsboard_A20_defconfig"
BR2_TARGET_UBOOT_CUSTOM_DTS_PATH="$(BR2_EXTERNAL_PPUZICKS_PATH)/board/haoyu/a20_marsboard/dts/uboot/sun7i-a20-marsboard.dts"
#BR2_TARGET_UBOOT_PATCH="$(BR2_EXTERNAL_PPUZICKS_PATH)/board/haoyu/a20_marsboard/patches/uboot/0001-add_a20_marsboard.patch"
BR2_TARGET_UBOOT_NEEDS_DTC=y
BR2_TARGET_UBOOT_NEEDS_PYTHON3=y
BR2_TARGET_UBOOT_NEEDS_PYLIBFDT=y
#BR2_TARGET_UBOOT_FORMAT_BIN=y
#BR2_TARGET_UBOOT_SPL=y
#BR2_TARGET_UBOOT_SPL_NAME="u-boot-sunxi-with-spl.bin"
BR2_TARGET_UBOOT_FORMAT_CUSTOM=y
BR2_TARGET_UBOOT_FORMAT_CUSTOM_NAME="u-boot-sunxi-with-spl.bin"
BR2_PACKAGE_HOST_UBOOT_TOOLS=y
BR2_PACKAGE_HOST_UBOOT_TOOLS_BOOT_SCRIPT=y
BR2_PACKAGE_HOST_UBOOT_TOOLS_BOOT_SCRIPT_SOURCE="$(BR2_EXTERNAL_PPUZICKS_PATH)/board/haoyu/a20_marsboard/boot.cmd"
#BR2_TARGET_UBOOT_BOOT_SCRIPT_SOURCE=

BR2_INIT_SYSTEMD=y



BR2_PACKAGE_MTD=y
BR2_PACKAGE_MTD_JFFS_UTILS=y

BR2_PACKAGE_DOCKER_CLI=y
BR2_PACKAGE_DOCKER_COMPOSE=y
BR2_PACKAGE_DOCKER_ENGINE=y
BR2_PACKAGE_CA_CERTIFICATES=y

#BR2_PACKAGE_NETWORK_MANAGER=y
#BR2_PACKAGE_DHCP=y
#BR2_PACKAGE_DHCP_CLIENT=y
BR2_PACKAGE_E2FSPROGS=y

# connman package
BR2_PACKAGE_CONNMAN=y
BR2_PACKAGE_CONNMAN_IPTABLES=y
BR2_PACKAGE_CONNMAN_ETHERNET=y
BR2_PACKAGE_CONNMAN_WIFI=y
BR2_PACKAGE_CONNMAN_BLUETOOTH=y
BR2_PACKAGE_CONNMAN_LOOPBACK=y
BR2_PACKAGE_CONNMAN_CLIENT=y

BR2_PACKAGE_LINUX_FIRMWARE=y
BR2_PACKAGE_LINUX_FIRMWARE_BRCM_BCM43XXX=y
BR2_PACKAGE_LINUX_FIRMWARE_RALINK_RT2XX=y
BR2_PACKAGE_LINUX_FIRMWARE_RTL_81XX=y
BR2_PACKAGE_LINUX_FIRMWARE_RTL_88XX=y
BR2_PACKAGE_SUNXI_MALI_MAINLINE=y
BR2_PACKAGE_SUNXI_MALI_MAINLINE_DRIVER=n

BR2_PACKAGE_IW=y
BR2_PACKAGE_WIRELESS_TOOLS=y
BR2_PACKAGE_WIRELESS_TOOLS_LIB=y
BR2_PACKAGE_WPA_SUPPLICANT=y
BR2_PACKAGE_WPA_SUPPLICANT_NL80211=y
BR2_PACKAGE_WPA_SUPPLICANT_CLI=y
BR2_PACKAGE_WPA_SUPPLICANT_AUTOSCAN=y
BR2_PACKAGE_WPA_SUPPLICANT_WPA3=y
BR2_PACKAGE_WPA_SUPPLICANT_PASSPHRASE=y
BR2_PACKAGE_WPA_SUPPLICANT_AP_SUPPORT=y
BR2_PACKAGE_WPA_SUPPLICANT_EAP=y
BR2_PACKAGE_WPA_SUPPLICANT_WPS=y
BR2_PACKAGE_WPA_SUPPLICANT_DEBUG_SYSLOG=y
BR2_PACKAGE_WPA_SUPPLICANT_DBUS=y
BR2_PACKAGE_WPA_SUPPLICANT_DBUS_INTROSPECTION=y
```

## package/nlohmannjson/Config.in
```kconfig
config BR2_PACKAGE_NLOHMANNJSON
  bool "nlohmann json"
  depends on BR2_INSTALL_LIBSTDCPP
  help
    JSON for Modern C++
```

## package/sdbuscpp/Config.in
```kconfig
config BR2_PACKAGE_SDBUSCPP
	bool "sdbuscpp"
	depends on BR2_INSTALL_LIBSTDCPP
	depends on BR2_PACKAGE_SYSTEMD
	depends on BR2_TOOLCHAIN_GCC_AT_LEAST_7 # C++17
	help
		High-level C++ D-Bus library for Linux designed to provide 
		easy-to-use yet powerful API in modern C++.

		https://github.com/Kistler-Group/sdbus-cpp


comment "sdbus-c++ needs systemd and a toolchain w/ C++, gcc >= 7"
	depends on !BR2_PACKAGE_SYSTEMD || !BR2_INSTALL_LIBSTDCPP || \
		!BR2_TOOLCHAIN_GCC_AT_LEAST_7
```

## package/sdbuscpp/Config.in.host
```kconfig
config BR2_PACKAGE_HOST_SDBUSCPP
	bool "host-sdbuscpp"
	select BR2_PACKAGE_HOST_PKGCONF
	help
		High-level C++ D-Bus library for Linux designed to provide 
		easy-to-use yet powerful API in modern C++.

		https://github.com/Kistler-Group/sdbus-cpp
```
