## Config.in
```kconfig
source "$BR2_EXTERNAL_PPUZICKS_PATH/package/le-gateway/Config.in"
source "$BR2_EXTERNAL_PPUZICKS_PATH/package/libspacenorm/Config.in"
source "$BR2_EXTERNAL_PPUZICKS_PATH/package/plog/Config.in"
source "$BR2_EXTERNAL_PPUZICKS_PATH/package/sdbuscpp/Config.in"
source "$BR2_EXTERNAL_PPUZICKS_PATH/package/sdbuscpp/Config.in.host"
```

## buildroot-external/Config.in
```kconfig
source "$BR2_EXTERNAL_MINE_PATH/package/le-gateway/Config.in"
source "$BR2_EXTERNAL_MINE_PATH/package/libspacenorm/Config.in"
source "$BR2_EXTERNAL_MINE_PATH/package/plog/Config.in"
source "$BR2_EXTERNAL_MINE_PATH/package/sdbuscpp/Config.in"
source "$BR2_EXTERNAL_MINE_PATH/package/sdbuscpp/Config.in.host"
source "$BR2_EXTERNAL_MINE_PATH/package/dt-overlay-sunxi/Config.in"
source "$BR2_EXTERNAL_MINE_PATH/package/uwe5622/Config.in"
source "$BR2_EXTERNAL_MINE_PATH/package/dt-overlay-orangepi-zero2/Config.in"
```

## buildroot-external/configs/haoyu_a20_marsboard_defconfig
```kconfig
# Architecture
BR2_arm=y
BR2_cortex_a7=y
BR2_ARM_FPU_VFPV4=y
#BR2_ARM_EABIHF=y

BR2_CCACHE=y

BR2_PACKAGE_HOST_LINUX_HEADERS_CUSTOM_5_15=y

# Toolchain
BR2_TOOLCHAIN=y
BR2_TOOLCHAIN_USES_GLIBC=y
BR2_TOOLCHAIN_EXTERNAL=y
BR2_TOOLCHAIN_EXTERNAL_BOOTLIN=y
BR2_TOOLCHAIN_EXTERNAL_GLIBC=y
BR2_PACKAGE_HAS_TOOLCHAIN_EXTERNAL=y
BR2_PACKAGE_PROVIDES_TOOLCHAIN_EXTERNAL="toolchain-external-bootlin"
BR2_TOOLCHAIN_EXTERNAL_PREFIX="$(ARCH)-linux"
BR2_TOOLCHAIN_EXTERNAL_BOOTLIN_ARCH_SUPPORTS=y
BR2_TOOLCHAIN_EXTERNAL_BOOTLIN_ARMV7_EABIHF_GLIBC_STABLE=y
BR2_PACKAGE_HOST_GDB_ARCH_SUPPORTS=y


# System configuration
BR2_TARGET_GENERIC_HOSTNAME="a20-marsboard"
BR2_TARGET_GENERIC_ISSUE="Welcome to MarsBoard A20!"
BR2_PACKAGE_HOST_DOSFSTOOLS=y
BR2_PACKAGE_HOST_GENIMAGE=y
BR2_PACKAGE_HOST_MTOOLS=y

# Image
BR2_ROOTFS_POST_BUILD_SCRIPT="$(BR2_EXTERNAL_IOTGATEWAY_PATH)/board/haoyu/a20_marsboard/post-build.sh"
BR2_ROOTFS_POST_IMAGE_SCRIPT="support/scripts/genimage.sh"
BR2_ROOTFS_POST_SCRIPT_ARGS="-c $(BINARIES_DIR)/genimage.cfg"


BR2_ROOTFS_DEVICE_CREATION_DYNAMIC_MDEV=y
BR2_ROOTFS_OVERLAY="$(BR2_EXTERNAL_IOTGATEWAY_PATH)/board/haoyu/a20_marsboard/rootfs_overlay"

# Filesystem
BR2_TARGET_ROOTFS_EXT2=y
BR2_TARGET_ROOTFS_EXT2_4=y
BR2_TARGET_ROOTFS_EXT2_SIZE="512M"

# kernel
BR2_LINUX_KERNEL=y
BR2_LINUX_KERNEL_CUSTOM_VERSION=y
BR2_LINUX_KERNEL_CUSTOM_VERSION_VALUE="5.15.84"
BR2_LINUX_KERNEL_DEFCONFIG="sunxi"
BR2_LINUX_KERNEL_DTS_SUPPORT=y
BR2_LINUX_KERNEL_CUSTOM_DTS_PATH="$(BR2_EXTERNAL_IOTGATEWAY_PATH)/board/haoyu/a20_marsboard/dts/sun7i-a20-marsboard.dts"
BR2_LINUX_KERNEL_CONFIG_FRAGMENT_FILES="$(BR2_EXTERNAL_IOTGATEWAY_PATH)/board/haoyu/a20_marsboard/linux-extras.config"
BR2_LINUX_KERNEL_NEEDS_HOST_OPENSSL=y
BR2_LINUX_KERNEL_INSTALL_TARGET=y


# Bootloaders
BR2_TARGET_UBOOT=y
BR2_TARGET_UBOOT_PATCH="$(BR2_EXTERNAL_IOTGATEWAY_PATH)/board/haoyu/a20_marsboard/patches/uboot-2022.01"
BR2_TARGET_UBOOT_BUILD_SYSTEM_KCONFIG=y
BR2_TARGET_UBOOT_CUSTOM_VERSION=y
BR2_TARGET_UBOOT_CUSTOM_VERSION_VALUE="2022.01"
BR2_TARGET_UBOOT_USE_CUSTOM_CONFIG=y
BR2_TARGET_UBOOT_CUSTOM_CONFIG_FILE="$(BR2_EXTERNAL_IOTGATEWAY_PATH)/board/haoyu/a20_marsboard/uboot.config"
BR2_TARGET_UBOOT_CUSTOM_DTS_PATH="$(BR2_EXTERNAL_IOTGATEWAY_PATH)/board/haoyu/a20_marsboard/dts/sun7i-a20-marsboard.dts"
BR2_TARGET_UBOOT_NEEDS_DTC=y
BR2_TARGET_UBOOT_NEEDS_PYTHON3=y
BR2_TARGET_UBOOT_NEEDS_PYLIBFDT=y
BR2_TARGET_UBOOT_SPL=y
BR2_TARGET_UBOOT_SPL_NAME="u-boot-sunxi-with-spl.bin"

BR2_INIT_SYSTEMD=y

# sunxi package 
BR2_PACKAGE_SUNXI_TOOLS=y

# docker
BR2_PACKAGE_DOCKER_CLI=y
BR2_PACKAGE_DOCKER_COMPOSE=y
BR2_PACKAGE_DOCKER_ENGINE=y
BR2_PACKAGE_CA_CERTIFICATES=y

# connman package
BR2_PACKAGE_CONNMAN=y
BR2_PACKAGE_CONNMAN_IPTABLES=y
BR2_PACKAGE_CONNMAN_ETHERNET=y
BR2_PACKAGE_CONNMAN_WIFI=y
BR2_PACKAGE_CONNMAN_BLUETOOTH=y
BR2_PACKAGE_CONNMAN_LOOPBACK=y
BR2_PACKAGE_CONNMAN_CLIENT=y

BR2_PACKAGE_LINUX_FIRMWARE=y
BR2_PACKAGE_LINUX_FIRMWARE_BRCM_BCM43XXX=y
BR2_PACKAGE_LINUX_FIRMWARE_RALINK_RT2XX=y
BR2_PACKAGE_LINUX_FIRMWARE_RTL_81XX=y
BR2_PACKAGE_LINUX_FIRMWARE_RTL_88XX=y
BR2_PACKAGE_MALI_DRIVER=y


BR2_PACKAGE_IW=y
BR2_PACKAGE_WIRELESS_TOOLS=y
BR2_PACKAGE_WIRELESS_TOOLS_LIB=y
BR2_PACKAGE_WPA_SUPPLICANT=y
BR2_PACKAGE_WPA_SUPPLICANT_NL80211=y
BR2_PACKAGE_WPA_SUPPLICANT_CLI=y
BR2_PACKAGE_WPA_SUPPLICANT_AUTOSCAN=y
BR2_PACKAGE_WPA_SUPPLICANT_WPA3=y
BR2_PACKAGE_WPA_SUPPLICANT_PASSPHRASE=y
BR2_PACKAGE_WPA_SUPPLICANT_AP_SUPPORT=y
BR2_PACKAGE_WPA_SUPPLICANT_EAP=y
BR2_PACKAGE_WPA_SUPPLICANT_WPS=y
BR2_PACKAGE_WPA_SUPPLICANT_DEBUG_SYSLOG=y
BR2_PACKAGE_WPA_SUPPLICANT_DBUS=y
BR2_PACKAGE_WPA_SUPPLICANT_DBUS_INTROSPECTION=y

# 3D
BR2_PACKAGE_MESA3D=y
BR2_PACKAGE_MESA3D_GALLIUM_DRIVER_LIMA=y
BR2_PACKAGE_MESA3D_OPENGL_EGL=y
BR2_PACKAGE_MESA3D_OPENGL_ES=y

# Home Sensor
BR2_PACKAGE_LE_GATEWAY=y
BR2_PACKAGE_SDBUSCPP=y
BR2_PACKAGE_PLOG=y
BR2_PACKAGE_JSON_FOR_MODERN_CPP=y
BR2_PACKAGE_VSFTPD=y
```

## buildroot-external/configs/imx6dl_sabresd_defconfig
```kconfig
BR2_arm=y
BR2_cortex_a9=y
BR2_ARM_ENABLE_NEON=y
BR2_ARM_ENABLE_VFP=y
BR2_ARM_FPU_VFPV3=y

BR2_CCACHE=y

# Linux headers same as kernel, a 5.15 series
BR2_PACKAGE_HOST_LINUX_HEADERS_CUSTOM_5_15=y
BR2_ROOTFS_DEVICE_CREATION_DYNAMIC_MDEV=y
BR2_ROOTFS_OVERLAY="$(BR2_EXTERNAL_IOTGATEWAY_PATH)/board/freescale/imx6-sabresd/rootfs_overlay"

BR2_TOOLCHAIN_BUILDROOT_GLIBC=y
BR2_TOOLCHAIN_BUILDROOT_CXX=y

# Kernel
BR2_LINUX_KERNEL=y
BR2_LINUX_KERNEL_CUSTOM_VERSION=y
BR2_LINUX_KERNEL_CUSTOM_VERSION_VALUE="5.15.43"
BR2_LINUX_KERNEL_DEFCONFIG="imx_v6_v7"
BR2_LINUX_KERNEL_DTS_SUPPORT=y
BR2_LINUX_KERNEL_INTREE_DTS_NAME="imx6dl-sabresd"
BR2_LINUX_KERNEL_CONFIG_FRAGMENT_FILES="$(BR2_EXTERNAL_IOTGATEWAY_PATH)/board/freescale/imx6-sabresd/linux-extras.config"
BR2_LINUX_KERNEL_NEEDS_HOST_OPENSSL=y

# System
BR2_TARGET_GENERIC_GETTY_PORT="ttymxc0"

# required tools to create the SD card image
BR2_PACKAGE_HOST_DOSFSTOOLS=y
BR2_PACKAGE_HOST_GENIMAGE=y
BR2_PACKAGE_HOST_MTOOLS=y

# Filesystem
BR2_TARGET_GENERIC_HOSTNAME="imx6dl-sabresd"
BR2_TARGET_GENERIC_ISSUE="Welcome to Buildroot for the iMX6DL SabreSD"
BR2_TARGET_ROOTFS_EXT2=y
BR2_TARGET_ROOTFS_EXT2_4=y
BR2_TARGET_ROOTFS_EXT2_SIZE="512M"

# Bootloader
BR2_TARGET_UBOOT=y
BR2_TARGET_UBOOT_BUILD_SYSTEM_KCONFIG=y
BR2_TARGET_UBOOT_BOARD_DEFCONFIG="mx6sabresd"
BR2_TARGET_UBOOT_CUSTOM_VERSION=y
BR2_TARGET_UBOOT_CUSTOM_VERSION_VALUE="2022.01"
BR2_TARGET_UBOOT_CONFIG_FRAGMENT_FILES="$(BR2_EXTERNAL_IOTGATEWAY_PATH)/board/freescale/imx6-sabresd/uboot.config"
BR2_TARGET_UBOOT_FORMAT_IMG=y
BR2_TARGET_UBOOT_SPL=y
BR2_TARGET_UBOOT_SPL_NAME="SPL"
BR2_TARGET_UBOOT_NEEDS_OPENSSL=y

# Image
BR2_ROOTFS_POST_IMAGE_SCRIPT="board/freescale/common/imx/post-image.sh"

BR2_INIT_SYSTEMD=y

BR2_PACKAGE_FREESCALE_IMX=y
BR2_PACKAGE_FREESCALE_IMX_PLATFORM_IMX6Q=y
BR2_PACKAGE_IMX_ALSA_PLUGINS=n
BR2_PACKAGE_IMX_CODEC=y
BR2_PACKAGE_IMX_LIB=n
BR2_PACKAGE_IMX_VPU=y
BR2_PACKAGE_FIRMWARE_IMX=y
BR2_PACKAGE_IMX_GPU_G2D=y
BR2_PACKAGE_IMX_GPU_VIV=y
BR2_PACKAGE_KERNEL_MODULE_IMX_GPU_VIV=n

# connman package
BR2_PACKAGE_CONNMAN=y
BR2_PACKAGE_CONNMAN_IPTABLES=y
#BR2_PACKAGE_CONNMAN_ETHERNET=y
BR2_PACKAGE_CONNMAN_WIFI=y
BR2_PACKAGE_CONNMAN_BLUETOOTH=y
BR2_PACKAGE_CONNMAN_LOOPBACK=y
BR2_PACKAGE_CONNMAN_CLIENT=y

# systemd package
BR2_PACKAGE_SYSTEMD_RFKILL=y
```

## buildroot-external/configs/orangepi_3_lts_defconfig
```kconfig
BR2_aarch64=y
BR2_cortex_a53=y
BR2_ARM_FPU_VFPV4=y

BR2_CCACHE=y

BR2_GLOBAL_PATCH_DIR="$(BR2_EXTERNAL_IOTGATEWAY_PATH)/board/orangepi/orangepi-3-lts/patches"
BR2_PACKAGE_HOST_LINUX_HEADERS_CUSTOM_5_15=y
BR2_ROOTFS_DEVICE_CREATION_DYNAMIC_MDEV=y
BR2_ROOTFS_OVERLAY="$(BR2_EXTERNAL_IOTGATEWAY_PATH)/board/orangepi/orangepi-3-lts/rootfs_overlay"

BR2_TOOLCHAIN_BUILDROOT_GLIBC=y
BR2_TOOLCHAIN_BUILDROOT_CXX=y

# Firmware
BR2_TARGET_ARM_TRUSTED_FIRMWARE=y
BR2_TARGET_ARM_TRUSTED_FIRMWARE_CUSTOM_VERSION=y
BR2_TARGET_ARM_TRUSTED_FIRMWARE_CUSTOM_VERSION_VALUE="v2.6"
BR2_TARGET_ARM_TRUSTED_FIRMWARE_PLATFORM="sun50i_h6"
BR2_TARGET_ARM_TRUSTED_FIRMWARE_BL31=y

# Kernel
BR2_LINUX_KERNEL=y
BR2_LINUX_KERNEL_CUSTOM_VERSION=y
BR2_LINUX_KERNEL_CUSTOM_VERSION_VALUE="5.15.43"
BR2_LINUX_KERNEL_USE_ARCH_DEFAULT_CONFIG=y
BR2_LINUX_KERNEL_DTS_SUPPORT=y
BR2_LINUX_KERNEL_CUSTOM_DTS_PATH="$(BR2_EXTERNAL_IOTGATEWAY_PATH)/board/orangepi/orangepi-3-lts/dts/sun50i-h6-orangepi-3-lts.dts"
BR2_LINUX_KERNEL_CONFIG_FRAGMENT_FILES="$(BR2_EXTERNAL_IOTGATEWAY_PATH)/board/orangepi/orangepi-3-lts/linux-extras.config"
BR2_LINUX_KERNEL_NEEDS_HOST_OPENSSL=y
BR2_LINUX_KERNEL_INSTALL_TARGET=y
BR2_LINUX_KERNEL_DTB_KEEP_DIRNAME=y

# Bootloader
BR2_TARGET_UBOOT=y
BR2_TARGET_UBOOT_BUILD_SYSTEM_KCONFIG=y
BR2_TARGET_UBOOT_CUSTOM_VERSION=y
BR2_TARGET_UBOOT_CUSTOM_VERSION_VALUE="2022.01"
BR2_TARGET_UBOOT_USE_CUSTOM_CONFIG=y
BR2_TARGET_UBOOT_CUSTOM_CONFIG_FILE="$(BR2_EXTERNAL_IOTGATEWAY_PATH)/board/orangepi/orangepi-3-lts/uboot.defconfig"
BR2_TARGET_UBOOT_CONFIG_FRAGMENT_FILES="$(BR2_EXTERNAL_IOTGATEWAY_PATH)/board/orangepi/orangepi-3-lts/uboot.config"
BR2_TARGET_UBOOT_CUSTOM_DTS_PATH="$(BR2_EXTERNAL_IOTGATEWAY_PATH)/board/orangepi/orangepi-3-lts/dts/uboot/sun50i-h6-orangepi-3-lts.dts"
BR2_TARGET_UBOOT_NEEDS_DTC=y
BR2_TARGET_UBOOT_NEEDS_PYLIBFDT=y
BR2_TARGET_UBOOT_NEEDS_ATF_BL31=y
BR2_TARGET_UBOOT_SPL=y
BR2_TARGET_UBOOT_SPL_NAME="u-boot-sunxi-with-spl.bin"


# Filesystem
BR2_TARGET_GENERIC_ISSUE="Welcome to Orangepi 3 LTS"
BR2_TARGET_ROOTFS_EXT2=y
BR2_TARGET_ROOTFS_EXT2_4=y
BR2_TARGET_ROOTFS_EXT2_SIZE="512M"

BR2_PACKAGE_HOST_DOSFSTOOLS=y
BR2_PACKAGE_HOST_GENIMAGE=y
BR2_PACKAGE_HOST_MTOOLS=y

# image scripts
BR2_ROOTFS_POST_BUILD_SCRIPT="$(BR2_EXTERNAL_IOTGATEWAY_PATH)/board/orangepi/common/post-build.sh"
BR2_ROOTFS_POST_IMAGE_SCRIPT="support/scripts/genimage.sh"
BR2_ROOTFS_POST_SCRIPT_ARGS="-c $(BINARIES_DIR)/genimage.cfg"

BR2_PACKAGE_LINUX_FIRMWARE=y
BR2_PACKAGE_ARMBIAN_FIRMWARE=y


BR2_INIT_SYSTEMD=y

# sunxi package 
BR2_PACKAGE_SUNXI_TOOLS=y

BR2_PACKAGE_CONNMAN=y
BR2_PACKAGE_CONNMAN_IPTABLES=y
BR2_PACKAGE_CONNMAN_ETHERNET=y
BR2_PACKAGE_CONNMAN_WIFI=y
BR2_PACKAGE_CONNMAN_BLUETOOTH=y
BR2_PACKAGE_CONNMAN_LOOPBACK=y
BR2_PACKAGE_CONNMAN_CLIENT=y

# systemd package
BR2_PACKAGE_SYSTEMD_RFKILL=y

# 3D
#BR2_PACKAGE_MESA3D=y
#BR2_PACKAGE_MESA3D_GALLIUM_DRIVER_PANFROST=y
#BR2_PACKAGE_MESA3D_OPENGL_EGL=y
#BR2_PACKAGE_MESA3D_OPENGL_ES=y
```

## buildroot-external/configs/orangepi_4lts_defconfig
```kconfig
# Architecture
BR2_aarch64=y
BR2_cortex_a72_a53=y

BR2_CCACHE=y

#BR2_GLOBAL_PATCH_DIR="$(BR2_EXTERNAL_IOTGATEWAY_PATH)/board/orangepi/orangepi-4lts/patches"
BR2_PACKAGE_HOST_LINUX_HEADERS_CUSTOM_5_15=y
BR2_ROOTFS_DEVICE_CREATION_DYNAMIC_MDEV=y
BR2_ROOTFS_OVERLAY="$(BR2_EXTERNAL_IOTGATEWAY_PATH)/board/orangepi/orangepi-4lts/rootfs_overlay"

# Toolchain
BR2_TOOLCHAIN=y
BR2_TOOLCHAIN_USES_GLIBC=y
BR2_TOOLCHAIN_EXTERNAL=y
BR2_TOOLCHAIN_EXTERNAL_BOOTLIN=y
BR2_TOOLCHAIN_EXTERNAL_GLIBC=y
BR2_PACKAGE_HAS_TOOLCHAIN_EXTERNAL=y
BR2_PACKAGE_PROVIDES_TOOLCHAIN_EXTERNAL="toolchain-external-bootlin"
BR2_TOOLCHAIN_EXTERNAL_PREFIX="$(ARCH)-linux"
BR2_TOOLCHAIN_EXTERNAL_BOOTLIN_ARCH_SUPPORTS=y
BR2_TOOLCHAIN_EXTERNAL_BOOTLIN_ARMV7_EABIHF_GLIBC_STABLE=y
BR2_PACKAGE_HOST_GDB_ARCH_SUPPORTS=y

# Firmware
BR2_TARGET_ARM_TRUSTED_FIRMWARE=y
BR2_TARGET_ARM_TRUSTED_FIRMWARE_CUSTOM_VERSION=y
BR2_TARGET_ARM_TRUSTED_FIRMWARE_CUSTOM_VERSION_VALUE="v2.6"
BR2_TARGET_ARM_TRUSTED_FIRMWARE_PLATFORM="rk3399"
BR2_TARGET_ARM_TRUSTED_FIRMWARE_BL31=y
BR2_TARGET_ARM_TRUSTED_FIRMWARE_NEEDS_ARM32_TOOLCHAIN=y
BR2_TARGET_ARM_TRUSTED_FIRMWARE_IMAGES=""

# Bootloader
BR2_TARGET_UBOOT=y
BR2_TARGET_UBOOT_PATCH="$(BR2_EXTERNAL_IOTGATEWAY_PATH)/board/orangepi/orangepi-4lts/patches/uboot"
BR2_TARGET_UBOOT_BUILD_SYSTEM_KCONFIG=y
BR2_TARGET_UBOOT_CUSTOM_VERSION=y
BR2_TARGET_UBOOT_CUSTOM_VERSION_VALUE="2022.01"
BR2_TARGET_UBOOT_USE_CUSTOM_CONFIG=y
BR2_TARGET_UBOOT_CUSTOM_CONFIG_FILE="$(BR2_EXTERNAL_IOTGATEWAY_PATH)/board/orangepi/orangepi-4lts/uboot.defconfig"
BR2_TARGET_UBOOT_CONFIG_FRAGMENT_FILES="$(BR2_EXTERNAL_IOTGATEWAY_PATH)/board/orangepi/orangepi-4lts/uboot.config"
BR2_TARGET_UBOOT_CUSTOM_DTS_PATH="$(BR2_EXTERNAL_IOTGATEWAY_PATH)/board/orangepi/orangepi-4lts/dts/uboot/rk3399-orangepi-4lts.dts $(BR2_EXTERNAL_IOTGATEWAY_PATH)/board/orangepi/orangepi-4lts/dts/uboot/rk3399-orangepi-4lts-u-boot.dtsi"
BR2_TARGET_UBOOT_NEEDS_DTC=y
BR2_TARGET_UBOOT_NEEDS_PYTHON3=y
BR2_TARGET_UBOOT_NEEDS_ATF_BL31=y
BR2_TARGET_UBOOT_NEEDS_ATF_BL31_ELF=y
BR2_TARGET_UBOOT_FORMAT_CUSTOM=y
BR2_TARGET_UBOOT_FORMAT_CUSTOM_NAME="u-boot.itb"
BR2_TARGET_UBOOT_SPL=y
BR2_TARGET_UBOOT_SPL_NAME="idbloader.img"

# Kernel
BR2_LINUX_KERNEL=y
BR2_LINUX_KERNEL_PATCH="$(BR2_EXTERNAL_IOTGATEWAY_PATH)/patches/linux-5.15-rockchip64"
BR2_LINUX_KERNEL_CUSTOM_VERSION=y
BR2_LINUX_KERNEL_CUSTOM_VERSION_VALUE="5.15.84"
BR2_LINUX_KERNEL_USE_ARCH_DEFAULT_CONFIG=y
BR2_LINUX_KERNEL_DTS_SUPPORT=y
BR2_LINUX_KERNEL_INTREE_DTS_NAME="rockchip/rk3399-orangepi-4-lts"
#BR2_LINUX_KERNEL_CUSTOM_DTS_PATH="$(BR2_EXTERNAL_IOTGATEWAY_PATH)/board/orangepi/orangepi-4lts/dts/linux/rk3399-orangepi-4lts.dts"
BR2_LINUX_KERNEL_CONFIG_FRAGMENT_FILES="$(BR2_EXTERNAL_IOTGATEWAY_PATH)/board/orangepi/orangepi-4lts/linux-extras.config"
BR2_LINUX_KERNEL_NEEDS_HOST_OPENSSL=y
BR2_LINUX_KERNEL_INSTALL_TARGET=y
BR2_LINUX_KERNEL_DTB_KEEP_DIRNAME=y
BR2_LINUX_KERNEL_DTB_OVERLAY_SUPPORT=y

# Filesystem
BR2_TARGET_GENERIC_HOSTNAME="orangepi-4lts"
BR2_TARGET_GENERIC_ISSUE="Welcome to Buildroot for the Orange PI 4 LTS"
BR2_TARGET_ROOTFS_EXT2=y
BR2_TARGET_ROOTFS_EXT2_4=y
BR2_TARGET_ROOTFS_EXT2_SIZE="512M"

BR2_PACKAGE_HOST_DOSFSTOOLS=y
BR2_PACKAGE_HOST_GENIMAGE=y
BR2_PACKAGE_HOST_MTOOLS=y
BR2_PACKAGE_HOST_UBOOT_TOOLS=y
BR2_PACKAGE_HOST_UBOOT_TOOLS_BOOT_SCRIPT=y
BR2_PACKAGE_HOST_UBOOT_TOOLS_BOOT_SCRIPT_SOURCE="$(BR2_EXTERNAL_IOTGATEWAY_PATH)/board/orangepi/orangepi-4lts/boot.cmd"

#BR2_ROOTFS_POST_BUILD_SCRIPT="$(BR2_EXTERNAL_IOTGATEWAY_PATH)/board/orangepi/orangepi-4lts/post-build-old.sh"
BR2_ROOTFS_POST_BUILD_SCRIPT="$(BR2_EXTERNAL_IOTGATEWAY_PATH)/board/orangepi/orangepi-4lts/post-build.sh"
BR2_ROOTFS_POST_IMAGE_SCRIPT="support/scripts/genimage.sh"
BR2_ROOTFS_POST_SCRIPT_ARGS="-c $(BINARIES_DIR)/genimage.cfg"

BR2_INIT_SYSTEMD=y

BR2_PACKAGE_ROCKCHIP_MALI=y

# Wireless tools
BR2_PACKAGE_IW=y
BR2_PACKAGE_WIRELESS_TOOLS=y
BR2_PACKAGE_WIRELESS_TOOLS_LIB=y
BR2_PACKAGE_WPA_SUPPLICANT=y
BR2_PACKAGE_WPA_SUPPLICANT_NL80211=y
BR2_PACKAGE_WPA_SUPPLICANT_CLI=y
BR2_PACKAGE_WPA_SUPPLICANT_AUTOSCAN=y
BR2_PACKAGE_WPA_SUPPLICANT_WPA3=y
BR2_PACKAGE_WPA_SUPPLICANT_PASSPHRASE=y
BR2_PACKAGE_WPA_SUPPLICANT_AP_SUPPORT=y
BR2_PACKAGE_WPA_SUPPLICANT_EAP=y
BR2_PACKAGE_WPA_SUPPLICANT_WPS=y
BR2_PACKAGE_WPA_SUPPLICANT_DEBUG_SYSLOG=y
BR2_PACKAGE_WPA_SUPPLICANT_DBUS=y
BR2_PACKAGE_WPA_SUPPLICANT_DBUS_INTROSPECTION=y

BR2_PACKAGE_NETWORK_MANAGER=n

# connman package
BR2_PACKAGE_CONNMAN=y
BR2_PACKAGE_CONNMAN_IPTABLES=y
#BR2_PACKAGE_CONNMAN_ETHERNET=y
BR2_PACKAGE_CONNMAN_WIFI=y
BR2_PACKAGE_CONNMAN_BLUETOOTH=y
BR2_PACKAGE_CONNMAN_LOOPBACK=y
BR2_PACKAGE_CONNMAN_CLIENT=y

# systemd package
BR2_PACKAGE_SYSTEMD_RFKILL=y

# bluetooth
BR2_PACKAGE_BLUEZ5_UTILS=y
BR2_PACKAGE_BLUEZ5_UTILS_CLIENT=y
BR2_PACKAGE_BLUEZ5_UTILS_TOOLS=y
BR2_PACKAGE_BLUEZ5_UTILS_DEPRECATED=y
BR2_PACKAGE_BLUEZ5_UTILS_PLUGINS_MESH=n
BR2_PACKAGE_BRCM_PATCHRAM_PLUS=n

# 3D
BR2_PACKAGE_MESA3D=n
BR2_PACKAGE_MESA3D_GALLIUM_DRIVER_LIMA=n
BR2_PACKAGE_MESA3D_OPENGL_EGL=n
BR2_PACKAGE_MESA3D_OPENGL_ES=n

# Home Sensor
BR2_PACKAGE_LE_GATEWAY=y
BR2_PACKAGE_SDBUSCPP=y
BR2_PACKAGE_PLOG=y
BR2_PACKAGE_JSON_FOR_MODERN_CPP=y
BR2_PACKAGE_VSFTPD=y
```

## buildroot-external/package/dt-overlay-rockchip/Config.in
```kconfig
config BR2_PACKAGE_DT_OVERLAY_ROCKCHIP
  bool  "dt-overlay-rockchip"
  help
    This package contains DT overlays files (dtbo) for rockchip
    platforms.
    
```

## buildroot-external/package/dt-overlay-sunxi/Config.in
```kconfig
config BR2_PACKAGE_DT_OVERLAY_SUNXI
  bool  "dt-overlay-sunxi"
  help
    This package contains DT overlays files (dtbo) for sunxi
    platforms.
    
```

## buildroot-external/package/le-gateway/Config.in
```kconfig
config BR2_PACKAGE_LE_GATEWAY
  bool "LE Gateway"
  help
    Bluetooth LE Gateway for HomeSensor
```
